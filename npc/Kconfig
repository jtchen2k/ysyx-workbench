## npc/Kconfig
```kconfig
mainmenu "npc configuration menu"


menuconfig DEVICE
  bool "Devices"
  default y

if DEVICE

menuconfig HAS_SERIAL
  bool "Enable serial device"
  default y

if HAS_SERIAL
config SERIAL_MMIO
    hex "MMIO address of the serial controller"
    default 0xa00003f8
endif

menuconfig HAS_TIMER
  bool "Enable timer"
  default y

if HAS_TIMER
config RTC_MMIO
  hex "MMIO address of the timer"
  default 0xa0000048
endif # HAS_TIMER

menuconfig HAS_KEYBOARD
  bool "Enable keyboard"
  default y

if HAS_KEYBOARD
config I8042_DATA_PORT
  depends on HAS_PORT_IO
  hex "Port address of the keyboard controller"
  default 0x60

config I8042_DATA_MMIO
  hex "MMIO address of the keyboard controller"
  default 0xa0000060
endif # HAS_KEYBOARD

menuconfig HAS_VGA
  bool "Enable VGA"
  default y

if HAS_VGA
config FB_ADDR
  hex "Physical address of the VGA frame buffer"
  default 0xa1000000

config VGA_CTL_MMIO
  hex "MMIO address of the VGA controller"
  default 0xa0000100

config VGA_SHOW_SCREEN
  bool "Enable SDL SCREEN"
  default y

choice
  prompt "Screen Size"
  default VGA_SIZE_400x300
config VGA_SIZE_400x300
  bool "400 x 300"
config VGA_SIZE_800x600
  bool "800 x 600"
endchoice
endif # HAS_VGA

endif #DEVICE

menu "Debugging and Tracing"

config TRACE
    bool "Enable trace"
    default y

config ITRACE
    bool "Enable instruction trace"
    depends on TRACE
    default y

config MTRACE
    bool "Enable memory trace"
    depends on TRACE
    default y

config FTRACE
    bool "Enable function trace"
    depends on TRACE
    default y

config DTRACE
    bool "Enable device trace"
    depends on TRACE
    default y

config WTRACE
    bool "Enable waveform trace"
    depends on TRACE
    default y

config WAVEFORM_FILE
    string "Waveform file"
    depends on WTRACE
    default "waveform.vcd"

config DIFFTEST
    bool "Enable diff test"
    default y

config MAX_PRINT_INST
    int "Max number of instructions to print in stdio"
    default 10

endmenu
```
